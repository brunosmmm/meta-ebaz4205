## conf/distro/ebaz4205-dist.conf
```bitbake
require conf/distro/poky.conf

DISTRO = "ebaz4205-dist"
DISTRO_NAME = "EBAZ4205 Distro"
DISTRO_VERSION = "1.0.1"

DISTRO_FEATURES:append = " systemd x11 zeroconf"
VIRTUAL-RUNTIME_init_manager = "systemd"
DISTRO_FEATURES_BACKFILL_CONSIDERED = "sysvinit"
VIRTUAL-RUNTIME_base-utils = ""
VIRTUAL-RUNTIME_login_manager = "shadow"
DISTRO_FEATURES:remove = " busybox"

PACKAGE_CLASSES = "package_ipk"

VIRTUAL-RUNTIME_dev_manager = "udev"

PREFERRED_PROVIDER_virtual/kernel := "linux-xlnx"
PREFERRED_VERSION_linux-xlnx := "6.1%"

IMAGE_LINGUAS = "en-us"
```
